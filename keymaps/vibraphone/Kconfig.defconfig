## keymaps/vibraphone/Kconfig.defconfig
```kconfig
# Copyright (c) 2022 The ZMK Contributors
# SPDX-License-Identifier: MIT

if SHIELD_VIBRAPHONE_LEFT

config ZMK_KEYBOARD_NAME
	default "vibraphone"

config ZMK_SPLIT_BLE_ROLE_CENTRAL
	default y

endif

if SHIELD_VIBRAPHONE_LEFT || SHIELD_VIBRAPHONE_RIGHT

config ZMK_SPLIT
	default y

endif
```

## keymaps/vibraphone/Kconfig.shield
```kconfig
# Copyright (c) 2022 The ZMK Contributors
# SPDX-License-Identifier: MIT

config SHIELD_VIBRAPHONE_LEFT
	def_bool $(shields_list_contains,vibraphone_left)

config SHIELD_VIBRAPHONE_RIGHT
	def_bool $(shields_list_contains,vibraphone_right)
```
